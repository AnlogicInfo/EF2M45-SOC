
#include "elf2.h"

#include "platform.h"
#include "syscon.h"
#include "string.h"

#include "log.h"
#include "test_i2c.h"
#include "i2c.h"
#include "int_register.h"


unsigned char BMP1[] =
{  
0x00,0x00,0x00,0x00,0x00,0x00,0x00,0x00,0x00,0x00,0x00,0x00,0x00,0x00,0x00,0x00,
0x00,0x00,0x00,0x00,0x00,0x00,0x00,0x00,0x00,0x00,0x00,0x00,0x00,0x00,0x00,0x00,
0x00,0x00,0x00,0x00,0x00,0x00,0x00,0x00,0x00,0x00,0x00,0x00,0x00,0x00,0x00,0x00,
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0x00,0x00,0x00,0x00,0x00,0x00,0x00,0x00,0x00,0x00,0x00,0x00,0x00,0x00,0x00,0x00,
};


/**********************************************
// IIC Write Command
**********************************************/

static void Write_IIC_Command(unsigned char IIC_Command)
{
   uint8_t addr = 0x00;
   HAL_I2C0_SendAddrCmd(&addr,1);
   HAL_I2C0_WriteData(&IIC_Command, 1);

}

/**********************************************
// IIC Write Data
**********************************************/

static void Write_IIC_Data(unsigned char IIC_Data)
{
   uint8_t addr = 0x40;
   HAL_I2C0_SendAddrCmd(&addr,1);
   HAL_I2C0_WriteData(&IIC_Data, 1);
}




static void oled_start_display()
{
	Write_IIC_Command(0xAE);   //display off
	Write_IIC_Command(0x20);	//Set Memory Addressing Mode	
	Write_IIC_Command(0x10);	//00,Horizontal Addressing Mode;01,Vertical Addressing Mode;10,Page Addressing Mode (RESET);11,Invalid
	Write_IIC_Command(0xb0);	//Set Page Start Address for Page Addressing Mode,0-7
	Write_IIC_Command(0xc8);	//Set COM Output Scan Direction
	Write_IIC_Command(0x00);//---set low column address
	Write_IIC_Command(0x10);//---set high column address
	Write_IIC_Command(0x40);//--set start line address
	Write_IIC_Command(0x81);//--set contrast control register
	Write_IIC_Command(0xdf);
	Write_IIC_Command(0xa1);//--set segment re-map 0 to 127
	Write_IIC_Command(0xa6);//--set normal display
	Write_IIC_Command(0xa8);//--set multiplex ratio(1 to 64)
	Write_IIC_Command(0x3F);//
	Write_IIC_Command(0xa4);//0xa4,Output follows RAM content;0xa5,Output ignores RAM content
	Write_IIC_Command(0xd3);//-set display offset
	Write_IIC_Command(0x00);//-not offset
	Write_IIC_Command(0xd5);//--set display clock divide ratio/oscillator frequency
	Write_IIC_Command(0xf0);//--set divide ratio
	Write_IIC_Command(0xd9);//--set pre-charge period
	Write_IIC_Command(0x22); //
	Write_IIC_Command(0xda);//--set com pins hardware configuration
	Write_IIC_Command(0x12);
	Write_IIC_Command(0xdb);//--set vcomh
	Write_IIC_Command(0x20);//0x20,0.77xVcc
	Write_IIC_Command(0x8d);//--set DC-DC enable
	Write_IIC_Command(0x14);//
	Write_IIC_Command(0xaf);//--turn on oled panel 
}

 /**
  * @brief  OLED_SetPos，设置光标
  * @param  x,光标x位置
	*					y，光标y位置
  * @retval 无
  */
void OLED_SetPos(unsigned char x, unsigned char y) //设置起始点坐标
{ 
	Write_IIC_Command(0xb0+y);
	Write_IIC_Command(((x&0xf0)>>4)|0x10);
	Write_IIC_Command((x&0x0f)|0x01);
}
 /**
  * @brief  OLED_DrawBMP，显示BMP位图
  * @param  x0,y0 :起始点坐标(x0:0~127, y0:0~7);
	*					x1,y1 : 起点对角线(结束点)的坐标(x1:1~128,y1:1~8)
	* @retval 无
  */
void OLED_DrawBMP(unsigned char x0,unsigned char y0,unsigned char x1,unsigned char y1,unsigned char BMP[])
{
	unsigned int j=0;
	unsigned char x,y;

  if(y1%8==0)
		y = y1/8;
  else
		y = y1/8 + 1;
	for(y=y0;y<y1;y++)
	{
		OLED_SetPos(x0,y);
    for(x=x0;x<x1;x++)
		{
			Write_IIC_Data(BMP[j++]);
		}
	}
}
void oled_fill(unsigned char fill_Data) 
{
	unsigned char m,n;

	for(m=0;m<8;m++)
	{
		Write_IIC_Command(0xb0+m);		//page0-page1

		Write_IIC_Command(0x00);		//low column start address
		Write_IIC_Command(0x10);		//high column start address
		for(n=0;n<132;n++)
		{
			Write_IIC_Data(fill_Data);
		}

	}

}

void oled_cls(void) //clear screen
{
	oled_fill(0x00);
}


void oled_on(void)
{
	Write_IIC_Command(0X8D);
	Write_IIC_Command(0X14);
	Write_IIC_Command(0XAF);
}

void oled_off(void)
{
	Write_IIC_Command(0X8D);
	Write_IIC_Command(0X10);
	Write_IIC_Command(0XAE);
}

void test_i2c0_iomux(void)
{
	HAL_SYSCON_Function_IO_Set(I2C0_SCL,GPIO_7,1);
	HAL_SYSCON_Function_IO_Set(I2C0_SDA,GPIO_6,1);
}


void ds3231_read_data(void)
{
	uint8_t data[3];
    uint8_t addr = 0x0;
	HAL_I2C0_SendAddrCmd(&addr, 1);
	HAL_I2C0_ReadData_Polling(data,3);


}

void ds3231_write_data(void)
{
	uint8_t data[3] = {0x00,0x33,0x12};
    uint8_t addr = 0x0;
    HAL_I2C0_SendAddrCmd(&addr,1);
    HAL_I2C0_WriteData(data,3);
	
}

typedef struct
{
    uint8_t buf[10];
    uint8_t offset;
}i2s_env_t;

static i2s_env_t env;

#define RX_INT_LEVEL	4
#define TX_INT_LEVEL	0
void i2c0_isr(void *param)
{
	volatile uint16_t status;
    i2s_env_t *p = (i2s_env_t *)param;
    uint8_t *rx = p->buf;
	status = HAL_I2C0_Intr_Status();
	if(status & (1<<I2C_INTR_RX_FULL))
	{
        rx = rx + p->offset;
		HAL_I2C0_Read_fifo(rx,RX_INT_LEVEL);
        p->offset += RX_INT_LEVEL;
	}
}


void test_i2c0_ds3231_with_int()
{
	test_i2c0_iomux();
	
	I2C_InitTypeDef i2c0_cfg;
	memset(&i2c0_cfg,0,sizeof(I2C_InitTypeDef));
	i2c0_cfg.mode = i2c_Master;
	i2c0_cfg.dev_addr = 0xd0;		//example
	i2c0_cfg.addr_type = i2c_7_Addressing;
	i2c0_cfg.speed = i2c_StandardMode;
	i2c0_cfg.restart_en = 1;
	i2c0_cfg.timing = I2C_TIMING_DEFAULT;
    

	HAL_I2C0_Init(APB_CLK0,i2c0_cfg,NULL);
    HAL_I2C0_Int_Threshold_Set(TX_INT_LEVEL,RX_INT_LEVEL-1);
	HAL_I2C0_Mask_Set(HAL_I2C0_Mask_Get() & (~(1<<I2C_MASK_TX_EMPTY)));
    I2C0_Int_Register(i2c0_isr, &env);
	NVIC_EnableIRQ(I2C0_IRQn);
    uint8_t addr = 0x0;
    HAL_I2C0_SendAddrCmd(&addr,1);
	HAL_I2C0_ReadData(RX_INT_LEVEL*2);
	while(1);
	
}

void test_i2c0_ds3231()
{
	test_i2c0_iomux();

	I2C_InitTypeDef i2c0_cfg;
	memset(&i2c0_cfg,0,sizeof(I2C_InitTypeDef));
	i2c0_cfg.mode = i2c_Master;
	i2c0_cfg.dev_addr = 0xd0;		//example
	i2c0_cfg.addr_type = i2c_7_Addressing;
	i2c0_cfg.speed = i2c_FastMode;
	i2c0_cfg.restart_en = 1;
	i2c0_cfg.timing = I2C_TIMING_DEFAULT;

	HAL_I2C0_Init(APB_CLK0,i2c0_cfg,NULL);
    HAL_I2C0_Int_Threshold_Set(0,0);
	ds3231_write_data();
	
	ds3231_read_data();
	
}


void test_i2c0_oled()
{
	test_i2c0_iomux();

	I2C_InitTypeDef i2c0_cfg;
	memset(&i2c0_cfg,0,sizeof(I2C_InitTypeDef));
	i2c0_cfg.mode = i2c_Master;
	i2c0_cfg.dev_addr = 0x78;		//Boards can configure 0x78 OR 0x7A, default 0x78
	i2c0_cfg.addr_type = i2c_7_Addressing;
	i2c0_cfg.speed = i2c_FastMode;
	i2c0_cfg.restart_en = 1;
	i2c0_cfg.timing = I2C_TIMING_DEFAULT;
   
	HAL_I2C0_Init(APB_CLK0,i2c0_cfg,NULL);
	HAL_I2C0_Int_Threshold_Set(0,0);
	
	oled_start_display();
	oled_cls();
	oled_fill(0xff);
	OLED_DrawBMP(0,0,128,8,(unsigned char *)BMP1);//测试BMP位图显示
	oled_off();
	oled_on();
}



